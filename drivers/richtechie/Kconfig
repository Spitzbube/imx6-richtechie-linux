## drivers/richtechie/Kconfig
```kconfig
#
# richtechie support drivers
#

menu "richtechie support drivers"

source "drivers/richtechie/mma8452/Kconfig"
source "drivers/richtechie/battery/Kconfig"
source "drivers/richtechie/system/Kconfig"

endmenu
```

## drivers/richtechie/battery/Kconfig
```kconfig
#
# battery support
#

menu "battery support"

config RT_BATTERY
    tristate "battery support"
    depends on ARCH_MX6
    default y

endmenu
```

## drivers/richtechie/mma8452/Kconfig
```kconfig
#
# MMA8452 support
#

menu "MMA8452 support"

config RT_MMA8452
    tristate "MMA8452 support"
    depends on ARCH_MX6
    default y

endmenu
```

## drivers/richtechie/system/Kconfig
```kconfig
#
# richtechie syste control support
#

menu "richtechie syste control support"

config RT_SYSTEM
    tristate "richtechie syste control support"
    depends on ARCH_MX6
    default y

endmenu
```
